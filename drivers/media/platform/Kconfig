## sound/soc/mediatek/Kconfig
```kconfig
config SND_SOC_MEDIATEK
	tristate

config SND_SOC_MTK_SRAM
	tristate

config SND_SOC_MTK_SMART_PHONE
	tristate

config SND_SOC_MT8167
	tristate

config SND_SOC_MT8167_MT6392_MACH
	tristate "ASoC Audio driver for MT8167 with internal codec"
	depends on MACH_MT8167
	select SND_SOC_MT8167
	select SND_SOC_MT8167_CODEC
	select SND_SOC_MT6392_CODEC
	help
	  This adds support for ASoC machine driver for Mediatek MT8167
	  platforms with internal audio codec and speaker amplifier MT6392.
	  Select Y if you have such device.
	  If unsure select "N".

config SND_SOC_MT8167S_SOM_MACH
	tristate "ASoC Audio driver for MT8167SSOM"
	depends on MACH_MT8167
	select SND_SOC_MT8167
	select SND_SOC_TAS5782M
	select SND_SOC_MT8167_CODEC
	select SND_SOC_TLV320WN
	select SND_SOC_RT5680
	help
	  This adds support for ASoC machine driver for Mediatek MT8167 SOM
	  platforms with internal audio codec and speaker codec TAS5782M.
	  Select Y if you have such device.
	  If unsure select "N".

config MTK_SND_SOC_CODEC
	string "String for Mediatek audio codec"
	help
	  Specify Mediatek audio codec.
	  It depend on the string to choose the audio codec.
	  Say "mt6351" if you have mt6351 audio codec.
	  Say "mt6337" if you have mt6337 audio codec.
	  Say "mt6355" if you have mt6355 audio codec.

config MTK_SPEAKER
	bool "MTK SPEAKER AMP"
	help
	  If you say Y, enable MTK_SPEAKER_AMP
	  If the codec has internal speaker, enable this.
	  This is a config for mediatek internal speaker amp.
	  Generally you select "N", if unsupport it.

config SND_SOC_MTK_BTCVSD
	bool "MTK BT CVSD ALSA ARICHITECTURE"
	default n
	help
	  If you say Y, enable SND_SOC_MTK_BTCVSD.
	  This is for software BTCVSD. This enable
	  the function for transferring/receiving
	  BT encoded data to/from BT firmware.

config SND_SOC_MTK_SCP_SMARTPA
	bool "Smart Power Amplifier in Sensor Hub Processor"
	help
	  SmartPA(Smart Power Amplifie) provides speaker thermal
	  and excursion protection. This configuration makes
	  speaker protection processing in SCP(Sensor Hub Processor).
	  Select Y to enable CONFIG_SND_SOC_MTK_SCP_SMARTPA for
	  speaker protection in SCP.

config MTK_SND_SOC_NEW_ARCH
	bool "Support new audio architecture"
	select REGMAP_MMIO
	help
	  If you say Y, enable MTK_SND_SOC_NEW_ARCH.
	  Only enable this when you use refactored audio driver architecture.
	  If new chip after mt6757, we will enable this config.
	  Audio driver refactor to common folder and platform folder.

config MTK_AUDIO_TUNNELING_SUPPORT
	bool "Audio playback through dsp"
	select SND_SOC_COMPRESS
	help
	  Only enable this when we have DSP.
	  This makes audio output pass bitstream without any post processing.
	  The decoding process is done in DSP.
	  Select Y to enable MTK_AUDIO_TUNNELING_SUPPORT for DSP playback.

config MTK_VOW_BARGE_IN_SUPPORT
	bool "Support VOW barge-in"
	help
	  Only enable this when we support VOW and barge-in.
	  This improves the hot word recognition accuracy by
	  applying echo cancellation to remove speaker output signal.
	  Select Y to enable CONFIG_MTK_VOW_BARGE_IN_SUPPORT for
	  barge-in feature.

config SND_SOC_MTK_AUDIO_DSP
	bool "ASoC support for Mediatek audiodsp chip"
	default n
	help
	  This adds dsp driver for Mediatek boards
	  that can be used with other platforms
	  Select Y if you have such device.
	  If unsure select "N".
```
